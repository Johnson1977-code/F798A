## build/peripheral_nus/Kconfig/arch/Kconfig.tmp
```kconfig
# Load Zephyr Arch Kconfig descriptions.
osource "C:/ncs/F798-ssd1357/zephyr/arch/rx/Kconfig"
osource "C:/ncs/F798-ssd1357/zephyr/arch/x86/Kconfig"
osource "C:/ncs/F798-ssd1357/zephyr/arch/xtensa/Kconfig"
osource "C:/ncs/F798-ssd1357/zephyr/arch/sparc/Kconfig"
osource "C:/ncs/F798-ssd1357/zephyr/arch/riscv/Kconfig"
osource "C:/ncs/F798-ssd1357/zephyr/arch/posix/Kconfig"
osource "C:/ncs/F798-ssd1357/zephyr/arch/mips/Kconfig"
osource "C:/ncs/F798-ssd1357/zephyr/arch/arm64/Kconfig"
osource "C:/ncs/F798-ssd1357/zephyr/arch/arm/Kconfig"
osource "C:/ncs/F798-ssd1357/zephyr/arch/arc/Kconfig"
```

## build/peripheral_nus/Kconfig/boards/Kconfig.defconfig.tmp
```kconfig
# Load Zephyr board defconfig descriptions.
osource "C:/ncs/F798-ssd1357/zephyr/boards/nordic/nrf54l15dk/Kconfig.defconfig"
```

## build/peripheral_nus/Kconfig/boards/Kconfig.tmp
```kconfig
# Load Zephyr board Kconfig descriptions.
osource "C:/ncs/F798-ssd1357/zephyr/boards/nordic/nrf54l15dk/Kconfig"
```
